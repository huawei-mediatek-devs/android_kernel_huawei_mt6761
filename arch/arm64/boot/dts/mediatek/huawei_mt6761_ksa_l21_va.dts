#include <dt-bindings/interrupt-controller/arm-gic.h>
#include <dt-bindings/interrupt-controller/irq.h>
#include <dt-bindings/pinctrl/mt6761-pinfunc.h>
#include <dt-bindings/mmc/mt6761-msdc.h>
#include <dt-bindings/clock/mt6761-clk.h>

/dts-v1/;
/plugin/;

#include "huawei_audio/huawei_mt6735_accdet.dtsi"
#include "huawei_common/huawei_common.dtsi"
#include "huawei_mt6761_ksa_l21_va/huawei.dtsi"

&rootparam {
    mtk,boardid = <4 1 0 2>;
    mtk,board_name = "KSA_L21_VA";
    mtk,product_name = "KSA-L21";

};

&dev_detect{
    dc_dc = <1>;
    fflash = <1>;
};

&antenna_boardid_detect {
    expect_value = <2018>;
};

#include <k61v1_64_mexico/cust.dtsi>
#include "huawei_mt6761_ksa_l21_va/huawei-camera.dtsi"
&i2c5 {
	clock-frequency = <400000>;
};
/*End of this file, DO NOT ADD ANYTHING HERE*/

