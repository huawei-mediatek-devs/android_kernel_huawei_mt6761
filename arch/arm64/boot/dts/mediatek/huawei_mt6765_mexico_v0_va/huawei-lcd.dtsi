#include "../lcdkit3.0/mex/devkit_lcd_kit.dtsi"

&huawei_lcd_panel {
		compatible = "huawei,lcd_panel_type";
		product_id = <1000>;
		detect_type = <2>; /*0:DETECT_GPIOID  1:DETECT_CHIPID  2:DETECT_LCD_TYPE */
		gpio_id = <169 178>; /*ID0 ID1*/
		gpio_cfg_addr = <0xE896CF1c 0xE896CF20>; /*IOCG*/
		support_lcd_type = "LCD_KIT";
		iovcc_ctrl_mode = <1>;
};