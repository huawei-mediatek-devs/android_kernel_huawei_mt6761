#include <dt-bindings/interrupt-controller/arm-gic.h>
#include <dt-bindings/interrupt-controller/irq.h>
#include <dt-bindings/pinctrl/mt6761-pinfunc.h>
#include <dt-bindings/mmc/mt6761-msdc.h>
#include <dt-bindings/clock/mt6761-clk.h>

/dts-v1/;
/plugin/;

#include "huawei_audio/huawei_mt6735_accdet.dtsi"
#include "huawei_common/huawei_common.dtsi"
#include "huawei_mt6761_ksa_tl00a_vd/huawei.dtsi"

&rootparam {
    mtk,boardid = <4 2 9 6>;
    mtk,board_name = "KSA_TL00_VD";
    mtk,product_name = "KSA-TL00";

};

&dev_detect{
    dc_dc = <1>;
    fflash = <1>;
};

&antenna_boardid_detect {
    expect_value = <2128>;
};

#include <k61v1_64_mexico/cust.dtsi>
#include "huawei_mt6761_ksa_tl00a_vd/huawei-camera.dtsi"
&i2c5 {
	clock-frequency = <400000>;
};
/*End of this file, DO NOT ADD ANYTHING HERE*/

