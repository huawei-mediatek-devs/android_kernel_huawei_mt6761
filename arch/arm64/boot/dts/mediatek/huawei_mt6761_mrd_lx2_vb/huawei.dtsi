#include "huawei-led.dtsi"
#include "huawei-tp.dtsi"
#include "huawei-charger.dtsi"
#include "huawei-wifi.dtsi"
#include "huawei-gnss.dtsi"
#include "huawei-lcd.dtsi"
#include "huawei-scp.dtsi"
#include "madrid_thermal_ntc.dtsi"
#include "huawei_sw_thermal_node.dtsi"