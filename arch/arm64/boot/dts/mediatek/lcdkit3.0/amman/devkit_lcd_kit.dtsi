/*---------------------------------------------------------------------------
 * This file is autogenerated file using huawei LCD parser. Please do not edit it.
 * Update input XML file to add a new entry or update variable in this file
 * Parser location: vendor/huawei/chipset_common/devkit/lcdkit/tools 
 *---------------------------------------------------------------------------*/


#include "amman_auo_otm1901a_5p2_1080p_video_default.dtsi"
#include "amman_boe_ili9881c_5p71_720p_video.dtsi"
#include "amman_inx_ili9881c_5p71_720p_video.dtsi"
#include "amman_truly_hx8394f_5p71_720p_video.dtsi"
#include "amman_trulyh_hsd_hx8394f_5p71_720p_video.dtsi"
#include "amman_txd_ili9881c_5p71_720p_video.dtsi"
#include "amman_txdh_hsd_ili9881c_5p71_720p_video.dtsi"