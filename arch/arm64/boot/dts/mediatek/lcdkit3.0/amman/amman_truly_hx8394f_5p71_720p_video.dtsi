/* Copyright (c) 2013, The Linux Foundation. All rights reserved.
 *
 * This program is free software; you can redistribute it and/or modify
 * it under the terms of the GNU General Public License version 2 and
 * only version 2 as published by the Free Software Foundation.
 *
 * This program is distributed in the hope that it will be useful,
 * but WITHOUT ANY WARRANTY; without even the implied warranty of
 * MERCHANTABILITY or FITNESS FOR A PARTICULAR PURPOSE.  See the
 * GNU General Public License for more details.
 */

/*-------------------------------------------------------------------------
 * This file is autogenerated file using gcdb parser. Please do not edit it.
 * Update input XML file to add a new entry or update variable in this file
 * VERSION = 1.1
 *-----------------------------------------------------------------------*/
&huawei_lcd_config {
	dsi_amman_truly_hx8394f_5p71_720p_video: lcd_kit_amman_truly_hx8394f_5p71_720p_video {
		compatible = "truly-hx8394f-5p71-720p-video";
		lcd-kit,panel-name = "TRULY_HX8394F 5P71 VIDEO TFT 720 x 1520";
		lcd-kit,panel-type = <0x01>;
		lcd-kit,panel-xres = <720>;
		lcd-kit,panel-yres = <1520>;
		lcd-kit,panel-width = <62>;
		lcd-kit,panel-height = <131>;
		lcd-kit,panel-on-cmds = <0x05 0x01 0x00 0x00 0x01 0x01 0x02 0x11 0x00
						 0x05 0x01 0x00 0x00 0x78 0x01 0x02 0x29 0x00
						 0x39 0x01 0x00 0x00 0x00 0x01 0x04 0xB9 0xFF 0x83 0x94
						 0x39 0x01 0x00 0x00 0x00 0x01 0x02 0xBC 0x00
						 0x39 0x01 0x00 0x00 0x00 0x01 0x02 0xCB 0x1B
						 0x39 0x01 0x00 0x00 0x00 0x01 0x02 0xCC 0x0B
						 0x39 0x01 0x00 0x00 0x00 0x01 0x02 0xC6 0xE5
						 0x39 0x01 0x00 0x00 0x00 0x01 0x03 0xC0 0x1F 0x31
						 0x39 0x01 0x00 0x00 0x00 0x01 0x02 0xD4 0x02>;
		lcd-kit,panel-on-cmds-state = "dsi_lp_mode";
		lcd-kit,panel-off-cmds = <0x05 0x01 0x00 0x00 0x14 0x01 0x02 0x28 0x00
						  0x05 0x01 0x00 0x00 0x40 0x01 0x02 0x10 0x00>;
		lcd-kit,panel-off-cmds-state = "dsi_hs_mode";
		lcd-kit,inversion-dot-cmds = <0x29 0x01 0x00 0x00 0x0a 0x00 0x02 0xB2 0x02>;
		lcd-kit,inversion-column-cmds = <0x29 0x01 0x00 0x00 0x0a 0x00 0x02 0xB2 0x00>;
		lcd-kit,esd-reg-cmds = <0x06 0x01 0x00 0x00 0x0a 0x00 0x01 0x0a
				 0x06 0x01 0x00 0x00 0x0a 0x00 0x01 0xcc>;
		lcd-kit,esd-value = <0x1c 0x0b>;
		lcd-kit,check-reg-cmds = <0x06 0x01 0x00 0x00 0x0a 0x00 0x01 0x0a>;
		lcd-kit,check-reg-cmds-state = "dsi_lp_mode";
		lcd-kit,check-reg-value = <0x1c>;
		lcd-kit,panel-bl-maxnit-command = <0x06 0x01 0x00 0x00 0x0a 0x00 0x01 0xdb>;
		lcd-kit,panel-bl-maxnit-command-state = "dsi_lp_mode";
		lcd-kit,panel-lcm-type = <2>;
		lcd-kit,panel-ldi-dsi-mode = <1>;
		lcd-kit,panel-dsi-switch-mode = <0>;
		lcd-kit,panel-dsi-switch-mode-en = <0>;
		lcd-kit,panel-ldi-trans-seq = <0>;
		lcd-kit,panel-ldi-data-padding = <0>;
		lcd-kit,panel-ldi-packet-size = <256>;
		lcd-kit,panel-ldi-ps = <2>;
		lcd-kit,panel-vfp-lp = <0>;
		lcd-kit,panel-fbk-div = <1>;
		lcd-kit,panel-orientation = <1>;
		lcd-kit,panel-bpp = <2>;
		lcd-kit,panel-bgr-fmt = <0>;
		lcd-kit,panel-cmd-type = <8>;
		lcd-kit,panel-pxl-clk = <0>;
		lcd-kit,panel-pxl-clk-div = <0>;
		lcd-kit,panel-data-rate = <669>;
		lcd-kit,mipi-lane-nums = <3>;
		lcd-kit,h-back-porch = <60>;
		lcd-kit,h-front-porch = <56>;
		lcd-kit,h-pulse-width = <20>;
		lcd-kit,v-back-porch = <4>;
		lcd-kit,v-front-porch = <10>;
		lcd-kit,v-pulse-width = <4>;
		lcd-kit,mipi-clk-post-adjust = <0>;
		lcd-kit,mipi-lp11-flag = <0>;
		lcd-kit,esd-support = <1>;
		lcd-kit,tp-color-support = <0>;
		lcd-kit,lcd-vsp = <2 27 6000000>;
		lcd-kit,lcd-vsn = <2 173 6000000>;
		lcd-kit,lcd-reset = <2 45 0>;
		lcd-kit,power-on-stage = <5 0 2
				7 1 0
				3 1 2
				4 1 10
				5 1 2
				5 0 2
				5 1 20
				6 1 0
				8 1 0>;
		lcd-kit,lp-on-stage = <0 0 0>;
		lcd-kit,hs-on-stage = <0 0 0>;
		lcd-kit,hs-off-stage = <0 0 0>;
		lcd-kit,lp-off-stage = <0 0 0>;
		lcd-kit,power-off-stage = <6 0 0
				7 0 0
				8 0 0
				5 0 2
				4 0 2
				3 0 5>;
		lcd-kit,pt-support = <1>;
		lcd-kit,panel-density = <320>;
		lcd-kit,ssc-disable = <1>;
		lcd-kit,inversion-support = <1>;
		lcd-kit,check-reg-support = <1>;
		lcd-kit,panel-bl-min = <2>;
		lcd-kit,panel-bl-max = <255>;
		lcd-kit,panel-bl-max-nit = <450>;
		lcd-kit,mipi-non-continue-enable = <0>;
		lcd-kit,panel-getblmaxnit-type = <1>;
		lcd-kit,panel-bl-ic-ctrl-type = <3>;
		lcd-kit,panel-bias-ic-ctrl-type = <3>;
		lcd-kit,panel-gpio-offset = <332>;
    };
};