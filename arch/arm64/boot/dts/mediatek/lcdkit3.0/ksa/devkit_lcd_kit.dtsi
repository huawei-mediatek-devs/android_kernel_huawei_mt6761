/*---------------------------------------------------------------------------
 * This file is autogenerated file using huawei LCD parser. Please do not edit it.
 * Update input XML file to add a new entry or update variable in this file
 * Parser location: vendor/huawei/chipset_common/devkit/lcdkit/tools 
 *---------------------------------------------------------------------------*/


#include "ksa_auo_otm1901a_5p2_1080p_video_default.dtsi"
#include "ksa_boe_ili9881c_5p71_720p_video.dtsi"
#include "ksa_inx_ili9881c_5p71_720p_video.dtsi"
#include "ksa_truly_hx8394f_5p71_720p_video.dtsi"
#include "ksa_trulyh_hsd_hx8394f_5p71_720p_video.dtsi"
#include "ksa_txd_ili9881c_5p71_720p_video.dtsi"
#include "ksa_txdh_hsd_ili9881c_5p71_720p_video.dtsi"