/*---------------------------------------------------------------------------
 * This file is autogenerated file using huawei LCD parser. Please do not edit it.
 * Update input XML file to add a new entry or update variable in this file
 * Parser location: vendor/huawei/chipset_common/devkit/lcdkit/tools 
 *---------------------------------------------------------------------------*/


#include "mad_auo_otm1901a_5p2_1080p_video_default.dtsi"
#include "mad_dsbj_ili9881c_6p08_720p_video.dtsi"
#include "mad_hx_hx8394f_6p08_720p_video.dtsi"
#include "mad_ofilm_hx8394f_6p08_720p_video.dtsi"
#include "mad_ofilmi_inx_hx8394f_6p08_720p_video.dtsi"
#include "mad_txd_hx8394f_6p08_720p_video.dtsi"