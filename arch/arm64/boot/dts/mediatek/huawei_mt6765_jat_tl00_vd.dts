#include <dt-bindings/interrupt-controller/arm-gic.h>
#include <dt-bindings/interrupt-controller/irq.h>
#include <dt-bindings/pinctrl/mt6765-pinfunc.h>
#include <dt-bindings/clock/mt6765-clk.h>
/dts-v1/;
/plugin/;

#include "huawei_common/huawei_common.dtsi"
#include "huawei_mt6765_jat_tl00_vd/huawei.dtsi"
#include "huawei_audio/huawei_mt6735_accdet.dtsi"
#include "huawei_audio/huawei_mt676x_audio_gpio.dtsi"

&rootparam {
    mtk,boardid = <4 2 0 1>;
    mtk,board_name = "JAT_TL00_VD";
    mtk,product_name = "JAT-TL00";
};

&antenna_boardid_detect {
    expect_value = <2016>;
};

#include <k62v1_64_mexico/cust.dtsi>
#include "huawei_mt6765_jat_tl00_vd/huawei-camera.dtsi"
/*End of this file, DO NOT ADD ANYTHING HERE*/

