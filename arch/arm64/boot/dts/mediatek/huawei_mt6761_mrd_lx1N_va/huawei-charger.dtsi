&charger {
	algorithm_name = "SwitchCharging";
	chg1_ta_ac_charger_current = <2000000>;
	chg2_ta_ac_charger_current = <2000000>;

	dpm_enable;
	vdpm_buf_limit = <100>;
	vdpm_para =
			"-32767", "4000", "4200", "50",
			"4000", "4200", "4400", "50",
			"4200", "32767", "4600", "50";
};

