#include "huawei-led.dtsi"
#include "huawei-tp.dtsi"
#include "huawei-charger.dtsi"
#include "huawei-wifi.dtsi"
#include "huawei-gnss.dtsi"
#include "huawei-lcd.dtsi"
#include "huawei-fingerprint.dtsi"
#include "huawei-audio.dtsi"
#include "huawei-nfc.dtsi"
#include "huawei-fm.dtsi"
#include "huawei-sensor.dtsi"
#include "amman_thermal_ntc.dtsi"
#include "huawei_sw_thermal_node.dtsi"