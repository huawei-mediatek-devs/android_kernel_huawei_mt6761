## drivers/huawei_platform/factory_cmdline_parse/Kconfig
```kconfig
#
# factory cmdline pares
#


config FACTORY_CMDLINE_PARSE
       bool "cmdline parse"
       default y
```

## drivers/huawei_platform/huawei_sw_thermal_node/Kconfig
```kconfig
# add four node for huawei thermal checking AR000AFR67
config HUAWEI_THERMAL_HWNODE
    tristate "Huawei Kernel State"    
    default y
    help
        Huawei kernel state, please choose it.
```

## drivers/rwlog/Kconfig
```kconfig
#
# huawei device state monitor configuration
#

config HUAWEI_RWLOG
	bool "huawei rwlog"
	default n
	help
	  If you say yes here you get support for huawei rwlog.
```
