## arch/arm64/configs/k61v1_64_mexico_defconfig
```kconfig
CONFIG_CROSS_COMPILE="aarch64-linux-gnu-"
# CONFIG_LOCALVERSION_AUTO is not set
# CONFIG_FHANDLE is not set
CONFIG_SCHED_WALT=y
CONFIG_LOG_BUF_SHIFT=20
CONFIG_CGROUP_DEBUG=y
CONFIG_CPUSETS=y
CONFIG_PROC_PID_CPUSET=y
CONFIG_CGROUP_SCHEDTUNE=y
CONFIG_BLK_CGROUP=y
CONFIG_CGROUP_IOLIMIT=y
CONFIG_SCHED_TUNE=y
CONFIG_DEFAULT_USE_ENERGY_AWARE=y
#config for HungTask
CONFIG_DETECT_HUNG_TASK=y
CONFIG_DETECT_HUAWEI_HUNG_TASK=y
CONFIG_DEFAULT_HUNG_TASK_TIMEOUT=120
CONFIG_BOOTPARAM_HUNG_TASK_PANIC=y
CONFIG_BOOTPARAM_HUNG_TASK_PANIC_VALUE=1
#config for Zerohung
CONFIG_HW_ZEROHUNG=y
#config for binder proc
CONFIG_TRACE_CLOCK=y
CONFIG_BINDER_HUAWEI_TRANSACTION_BRIEF=y
# CONFIG_RD_BZIP2 is not set
# CONFIG_RD_LZMA is not set
# CONFIG_RD_XZ is not set
# CONFIG_RD_LZO is not set
# CONFIG_RD_LZ4 is not set
CONFIG_SYSCTL_SYSCALL=y
# CONFIG_KALLSYMS_BASE_RELATIVE is not set
# CONFIG_SLUB_DEBUG is not set
CONFIG_CC_STACKPROTECTOR_STRONG=y
CONFIG_MODULE_SRCVERSION_ALL=y
# CONFIG_BLK_DEV_BSG is not set
CONFIG_HAVE_LIVEPATCH=y

#
# Enable Livepatch
#
CONFIG_LIVEPATCH=y
CONFIG_LIVEPATCH_STACK=y
CONFIG_BLK_DEV_THROTTLING=y
CONFIG_WBT=y
CONFIG_MACH_MT6761=y
CONFIG_SCHED_MC=y
CONFIG_NR_CPUS=8
CONFIG_PREEMPT=y
#config for kernel ko online sign
CONFIG_SYSTEM_DATA_VERIFICATION=y
CONFIG_MODULE_SIG=y
CONFIG_MODULE_SIG_FORCE=y
CONFIG_MODULE_SIG_ALL=y
# CONFIG_MODULE_SIG_SHA1 is not set
# CONFIG_MODULE_SIG_SHA224 is not set
# CONFIG_MODULE_SIG_SHA256 is not set
# CONFIG_MODULE_SIG_SHA384 is not set
CONFIG_MODULE_SIG_SHA512=y
CONFIG_MODULE_SIG_HASH="sha512"
CONFIG_MODULE_SIG_KEY="huawei_signing_key.pem"
# CONFIG_BOUNCE is not set
CONFIG_CMA_AREAS=1
CONFIG_ZSMALLOC=y
CONFIG_RANDOMIZE_BASE=y
CONFIG_CMDLINE="console=tty0 console=ttyMT3,921600n1 root=/dev/ram vmalloc=496M slub_max_order=0 slub_debug=O "
# CONFIG_EFI is not set
CONFIG_BUILD_ARM64_APPENDED_DTB_IMAGE=y
CONFIG_BUILD_ARM64_APPENDED_DTB_IMAGE_NAMES="mediatek/mt6761"
CONFIG_BUILD_ARM64_DTB_OVERLAY_IMAGE_NAMES="mediatek/k61v1_64_mexico mediatek/huawei_mt6761_mrd_l23_va mediatek/huawei_mt6761_mrd_l23_vb mediatek/huawei_mt6761_mrd_lx1_va mediatek/huawei_mt6761_mrd_lx1N_va mediatek/huawei_mt6761_mrd_lx2_va mediatek/huawei_mt6761_mrd_lx2_vb mediatek/huawei_mt6761_mrd_lx1_vb mediatek/huawei_mt6761_mrd_lx1F_va mediatek/huawei_mt6761_amn_l29_va mediatek/huawei_mt6761_amn_l23_va mediatek/huawei_mt6761_amn_l22_va mediatek/huawei_mt6761_ksa_al00_va mediatek/huawei_mt6761_ksa_tl00_va mediatek/huawei_mt6761_amn_l23_vb mediatek/huawei_mt6761_ksa_lx9_va mediatek/huawei_mt6761_ksa_l22_va mediatek/huawei_mt6761_ksa_lx3_va mediatek/huawei_mt6761_mrd_lx1N_vb mediatek/huawei_mt6761_mrd_lx1_vc mediatek/huawei_mt6761_ksa_al00_vb mediatek/huawei_mt6761_amn_l29_vb mediatek/huawei_mt6761_ksa_l29_vb mediatek/huawei_mt6761_amn_l22_vb mediatek/huawei_mt6761_ksa_l22_vb mediatek/huawei_mt6761_amn_l21_va mediatek/huawei_mt6761_ksa_l21_va mediatek/huawei_mt6761_ksa_al00b_va mediatek/huawei_mt6761_amn_l29_vc mediatek/huawei_mt6761_amn_l23_vc mediatek/huawei_mt6761_amn_l22_vc mediatek/huawei_mt6761_ksa_l29_vc mediatek/huawei_mt6761_ksa_l23_vc mediatek/huawei_mt6761_ksa_l22_vc mediatek/huawei_mt6761_amn_l29_vd mediatek/huawei_mt6761_amn_l23_vd mediatek/huawei_mt6761_ksa_tl00a_vd mediatek/huawei_mt6761_mrd_l23_vc"
# CONFIG_CORE_DUMP_DEFAULT_ELF_HEADERS is not set
CONFIG_COMPAT=y
CONFIG_WQ_POWER_EFFICIENT_DEFAULT=y
CONFIG_CPU_FREQ=y
CONFIG_CPU_FREQ_STAT=y
CONFIG_CPU_FREQ_STAT_DETAILS=y
CONFIG_CPU_FREQ_DEFAULT_GOV_INTERACTIVE=y
CONFIG_CPU_FREQ_GOV_POWERSAVE=y
CONFIG_CPU_FREQ_GOV_USERSPACE=y
CONFIG_CPU_FREQ_GOV_ONDEMAND=y
CONFIG_XFRM_SUB_POLICY=y
CONFIG_XFRM_MIGRATE=y
CONFIG_IP_PNP=y
CONFIG_IP_PNP_DHCP=y
CONFIG_IP_PNP_BOOTP=y
CONFIG_NET_IPIP=y
CONFIG_IP_MROUTE=y
CONFIG_IP_MROUTE_MULTIPLE_TABLES=y
CONFIG_IP_PIMSM_V1=y
CONFIG_IP_PIMSM_V2=y
CONFIG_SYN_COOKIES=y
CONFIG_INET_AH=y
CONFIG_INET_IPCOMP=y
CONFIG_TCP_AUTOTUNING=y
CONFIG_INET6_XFRM_MODE_ROUTEOPTIMIZATION=y
CONFIG_IPV6_SIT_6RD=y
CONFIG_IPV6_SUBTREES=y
CONFIG_IPV6_MROUTE=y
CONFIG_IPV6_PIMSM_V2=y
CONFIG_BRIDGE_NETFILTER=y
CONFIG_NETFILTER_XT_MATCH_CONNBYTES=y
CONFIG_NETFILTER_XT_MATCH_MULTIPORT=y
CONFIG_NETFILTER_XT_MATCH_PHYSDEV=y
CONFIG_NETFILTER_XT_MATCH_QUOTA2_LOG=y
CONFIG_NETFILTER_XT_MATCH_REALM=y
CONFIG_NETFILTER_XT_MATCH_RECENT=y
CONFIG_NETFILTER_XT_MATCH_TCPMSS=y
CONFIG_IP6_NF_MATCH_FRAG=y
CONFIG_IP6_NF_MATCH_IPV6HEADER=y
CONFIG_IP6_NF_TARGET_HL=y
CONFIG_BRIDGE=y
CONFIG_VLAN_8021Q=y
CONFIG_NET_SCH_INGRESS=y
CONFIG_NET_CLS_FW=y
CONFIG_CLS_U32_PERF=y
CONFIG_CLS_U32_MARK=y
CONFIG_NET_CLS_FLOW=y
CONFIG_NET_ACT_POLICE=y
CONFIG_NET_ACT_MIRRED=y
CONFIG_NET_ACT_IPT=y
CONFIG_NET_CLS_IND=y
CONFIG_CFG80211=y
CONFIG_NL80211_TESTMODE=y
CONFIG_CFG80211_DEVELOPER_WARNINGS=y
# CONFIG_CFG80211_DEFAULT_PS is not set
CONFIG_CFG80211_INTERNAL_REGDB=y
CONFIG_ZRAM=y
CONFIG_BLK_DEV_LOOP=y
CONFIG_MEDIATEK_SOLUTION=y
CONFIG_MTK_PLATFORM="mt6761"
CONFIG_ARCH_MTK_PROJECT="k61v1_64_mexico"
CONFIG_MTK_GPT_SCHEME_SUPPORT=y
# CONFIG_MTK_BLOCK_TAG is not set
CONFIG_MTK_IO_BOOST=y
CONFIG_MTK_PID_MAP=y
CONFIG_MTK_FREQ_HOPPING=y
CONFIG_MTK_CPU_FREQ=y
CONFIG_MTK_PTPOD=y
CONFIG_MTK_STATIC_POWER=y
CONFIG_MTK_UNIFY_POWER=y
CONFIG_MTK_CM_MGR=y
CONFIG_MTK_PMIC_NEW_ARCH=y
CONFIG_MTK_PMIC_COMMON=y
CONFIG_MTK_PMIC_CHIP_MT6357=y
CONFIG_MTK_EXTBUCK=y
CONFIG_MTK_AUXADC_INTF=y
CONFIG_REGULATOR_RT5738=y
CONFIG_MFD_MT6370_PMU=y
CONFIG_MT6370_PMU_CHARGER=y
CONFIG_MT6370_PMU_FLED=y
CONFIG_MT6370_PMU_BLED=y
CONFIG_MT6370_PMU_LDO=y
CONFIG_MT6370_PMU_DSV=y
CONFIG_MTK_PMIC_WRAP_HAL=y
CONFIG_MTK_THERMAL_PA_VIA_ATCMD=y
CONFIG_CUSTOM_KERNEL_IMGSENSOR="hi1333_qtech ov13855_ofilm_tdk ov13855_ofilm imx258_sunny_zet imx258_sunny s5k3l6_liteon ov8856_mipi_raw hi846_truly hi846_byd gc8034_foxconn s5k4h7_byd s5k4h7_ofilm hi556_liteary gc5025_holi hi556_holi gc5025_king"
CONFIG_IMGSENSOR_MAIN="hi1333_qtech ov13855_ofilm_tdk ov13855_ofilm imx258_sunny_zet imx258_sunny s5k3l6_liteon"
CONFIG_IMGSENSOR_SUB="ov8856_mipi_raw hi846_truly hi846_byd gc8034_foxconn s5k4h7_byd s5k4h7_ofilm hi556_liteary gc5025_holi hi556_holi gc5025_king"
CONFIG_MTK_VIDEOCODEC_DRIVER=y
CONFIG_MTK_SMI_EXT=y
CONFIG_MTK_CMDQ=y
CONFIG_MTK_CQDMA=y
CONFIG_MTK_IMGSENSOR=y
CONFIG_MTK_CAM_CAL=y
CONFIG_MTK_JPEG=y
CONFIG_MTK_LCM=y
CONFIG_CUSTOM_KERNEL_LCM="nt35695_fhd_dsi_vdo_truly_rt5081_hdp nt35695B_fhd_dsi_vdo_auo_rt5081_hdp lcdkit_mtk_common_panel ili9881c_hd_dsi_vdo hlt_hx8394f_hd_dsi_vdo"
CONFIG_MTK_SYNC=y
CONFIG_MTK_FB=y
CONFIG_MTK_LCM_PHYSICAL_ROTATION="0"
CONFIG_MTK_ROUND_CORNER_SUPPORT=y
CONFIG_LCM_HEIGHT="1560"
CONFIG_LCM_WIDTH="720"
# CONFIG_MTK_MMPROFILE_SUPPORT is not set
CONFIG_MTK_AAL_SUPPORT=y
CONFIG_MTK_DISPLAY_LOW_MEMORY_DEBUG_SUPPORT=y
CONFIG_MTK_DYNAMIC_FPS_FRAMEWORK_SUPPORT=y
CONFIG_MTK_SENSOR_SUPPORT=y
CONFIG_MTK_SENSORS_1_0=y
CONFIG_CUSTOM_KERNEL_ACCELEROMETER=y
CONFIG_MTK_ACCELHUB=y
CONFIG_CUSTOM_KERNEL_ALSPS=y
CONFIG_MTK_ALSPSHUB=y
# CONFIG_CUSTOM_KERNEL_MAGNETOMETER is not set
CONFIG_MTK_MAGHUB=y
CONFIG_MTK_HWMON=y
# CONFIG_CUSTOM_KERNEL_BAROMETER is not set
CONFIG_MTK_BAROHUB=y
# CONFIG_CUSTOM_KERNEL_GRV_SENSOR is not set
# CONFIG_CUSTOM_KERNEL_GMRV_SENSOR is not set
# CONFIG_CUSTOM_KERNEL_RV_SENSOR is not set
# CONFIG_CUSTOM_KERNEL_LINEARACCEL_SENSOR is not set
# CONFIG_CUSTOM_KERNEL_GRAVITY_SENSOR is not set
# CONFIG_CUSTOM_KERNEL_UNCALI_MAG_SENSOR is not set
CONFIG_HUAWEI_SENSOR=y
CONFIG_CUSTOM_HW_MOTION=y
CONFIG_CUSTOM_KERNEL_STEP_COUNTER=y
CONFIG_MTK_STEPSIGNHUB=y
CONFIG_CUSTOM_KERNEL_SITUATION=y
CONFIG_MTK_STATHUB=y
CONFIG_MTK_WAKEHUB=n
CONFIG_MTK_GLGHUB=n
CONFIG_MTK_PICKUPHUB=n
CONFIG_MTK_DEVICE_ORIENTATION_HUB=y
CONFIG_MTK_TILTDETECTHUB=n
CONFIG_MTK_SAR_HUB=y
CONFIG_CUSTOM_KERNEL_SENSORHUB=y
CONFIG_MTK_MD1_SUPPORT=12
CONFIG_MTK_C2K_LTE_MODE=2
CONFIG_MTK_COMBO=y
CONFIG_MTK_COMBO_CHIP_CONSYS_6761=y
CONFIG_MTK_COMBO_BT=y
CONFIG_MTK_COMBO_GPS=y
CONFIG_MTK_COMBO_WIFI=y
CONFIG_HUAWEI_WIFI=y
CONFIG_HW_DPIMARK_MODULE=y
CONFIG_HW_NETWORK_AWARE=y
CONFIG_HW_WIFI=y
CONFIG_HW_WIFIPRO=y
CONFIG_HW_WIFIPRO_PROC=y
CONFIG_CHR_NETLINK_MODULE=y
CONFIG_MTK_WAPI_SUPPORT=y
CONFIG_MTK_DHCPV6C_WIFI=y
CONFIG_MTK_GPS_SUPPORT=y
CONFIG_MTK_GPS_EMI=y
CONFIG_MTK_FMRADIO=y
CONFIG_MTK_FM_CHIP="MT6631_FM"
CONFIG_MTK_CONNSYS_DEDICATED_LOG_PATH=y
CONFIG_MTK_ECCCI_DRIVER=y
CONFIG_MTK_ECCCI_C2K=y
CONFIG_MTK_BTIF=y
CONFIG_MTK_ACCDET=y
CONFIG_ACCDET_EINT_IRQ=y
CONFIG_ACCDET_SUPPORT_EINT0=y
CONFIG_MTK_DRAM_LOG_STORE=y
CONFIG_MTK_DRAM_LOG_STORE_ADDR=0x0010E700
CONFIG_MTK_DRAM_LOG_STORE_SIZE=0x100
CONFIG_MTK_AUXADC=y
CONFIG_MTK_DEVAPC_DRIVER=y
CONFIG_MTK_LEDS=y
CONFIG_MTK_PWM=y
CONFIG_MTK_VIBRATOR=y
CONFIG_MTK_CHIP=y
CONFIG_MTK_USER_SPACE_GLOBAL_CPUSET=y
CONFIG_MTK_IDLE_BALANCE_ENHANCEMENT=y
CONFIG_MTK_SCHED_EAS_POWER_SUPPORT=y
CONFIG_CPU_FREQ_GOV_SCHEDPLUS=y
CONFIG_SCHED_HMP=y
CONFIG_MTK_SCHED_BOOST=y
CONFIG_MTK_SCHED_RQAVG_KS=y
CONFIG_MTK_SCHED_RQAVG_US=y
CONFIG_MTK_SCHED_CPULOAD=y
CONFIG_MTK_TINYSYS_SCP_SUPPORT=y
CONFIG_MTK_TINYSYS_SSPM_SUPPORT=y
CONFIG_MTK_MET_MEM_ALLOC=y
CONFIG_MTK_USB_TYPEC_U3_MUX=y
# CONFIG_TCPC_CLASS is not set
# CONFIG_USB_POWER_DELIVERY is not set
# CONFIG_TCPC_MT6370 is not set
CONFIG_MTK_GPU_SUPPORT=y
CONFIG_MTK_GPU_VERSION="rgx clark m1.9ED4971894"
CONFIG_MTK_GPU_COMMON_DVFS_SUPPORT=y
CONFIG_MTK_RTC=y
CONFIG_MTK_RAM_CONSOLE=y
CONFIG_MTK_RAM_CONSOLE_USING_SRAM=y
CONFIG_MTK_RAM_CONSOLE_SIZE=0x800
CONFIG_MTK_RAM_CONSOLE_ADDR=0x0010DC00
CONFIG_MTK_RAM_CONSOLE_DRAM_SIZE=0x10000
CONFIG_MTK_RAM_CONSOLE_DRAM_ADDR=0x47C80000
CONFIG_MTK_AEE_FEATURE=y
CONFIG_MTK_AEE_MRDUMP=y
CONFIG_MTK_LENS=y
CONFIG_MTK_FLASHLIGHT=y
CONFIG_MTK_FLASHLIGHT_MT6370=y
CONFIG_MTK_FLASHLIGHT_LM3643=y
CONFIG_MTK_FLASHLIGHT_PT_STRICT=y
CONFIG_MTK_FLASHLIGHT_DLPT=y
CONFIG_RT_FLASHLIGHT=y
CONFIG_USB_MTK_HDRC=y
CONFIG_MTK_MUSB_QMU_SUPPORT=y
CONFIG_MTK_MUSB_QMU_PURE_ZLP_SUPPORT=y
CONFIG_MTK_MUSB_DRV_36BIT=y
CONFIG_USB_MTK_OTG=y
CONFIG_MTK_CPU_CTRL_CFP=y
# CONFIG_MTK_FPSGO is not set
CONFIG_MTK_MEMCFG=y
CONFIG_MTPROF=y
CONFIG_MTK_TIMER_TIMESYNC=y
CONFIG_ANDROID_DEFAULT_SETTING=y
CONFIG_SCSI=y
CONFIG_BLK_DEV_SD=y
CONFIG_SCSI_SCAN_ASYNC=y
CONFIG_MD=y
CONFIG_BLK_DEV_DM=y
CONFIG_DM_CRYPT=y
CONFIG_DM_UEVENT=y
CONFIG_DM_VERITY=y
CONFIG_DM_VERITY_FEC=y
CONFIG_MTK_HW_FDE=y
CONFIG_IFB=y
# CONFIG_ETHERNET is not set
CONFIG_PPP_FILTER=y
CONFIG_PPP_MULTILINK=y
CONFIG_PPPOE=y
CONFIG_PPP_ASYNC=y
CONFIG_PPP_SYNC_TTY=y
# CONFIG_INPUT_MOUSEDEV is not set
CONFIG_INPUT_EVDEV=y
# CONFIG_KEYBOARD_ATKBD is not set
CONFIG_KEYBOARD_MTK=y
CONFIG_ONEKEY_REBOOT_NORMAL_MODE=y
CONFIG_ONEKEY_REBOOT_OTHER_MODE=y
CONFIG_KPD_PWRKEY_USE_PMIC=y
CONFIG_MTK_MRDUMP_KEY=y
CONFIG_HUAWEI_FINGERPRINT_SUPPORT=y
# CONFIG_INPUT_MOUSE is not set
CONFIG_INPUT_TOUCHSCREEN=y
#CONFIG_TOUCHSCREEN_MTK=y
# CONFIG_TOUCHSCREEN_PHYSICAL_ROTATION_WITH_LCM is not set
#CONFIG_TOUCHSCREEN_MTK_GT1151=y
#CONFIG_GT1151_FIRMWARE="firmware2"
#CONFIG_GT1151_CONFIG="config17"
#CONFIG_GTP_DRIVER_SEND_CFG=y
#CONFIG_GTP_CUSTOM_CFG=y
#CONFIG_GTP_AUTO_UPDATE=y
#CONFIG_GTP_REQUEST_FW_UPDATE=y
#CONFIG_GTP_CREATE_WR_NODE=y
#CONFIG_GTP_POWER_CTRL_SLEEP=y
CONFIG_HUAWEI_TP_KIT_COLOR_INFO_3_0=n
CONFIG_HUAWEI_DEVKIT_MTK_3_0=y
CONFIG_HUAWEI_TS_KIT_3_0=y
CONFIG_GOODIX_GT1X_TS_KIT_3_0=y
CONFIG_FOCAL_TS_KIT_3_0=y
CONFIG_INPUT_MISC=y
CONFIG_INPUT_UINPUT=y
# CONFIG_SERIO is not set
# CONFIG_VT is not set
CONFIG_LEGACY_PTY_COUNT=16
# CONFIG_DEVMEM is not set
# CONFIG_DEVKMEM is not set
CONFIG_SERIAL_8250=y
# CONFIG_SERIAL_8250_DEPRECATED_OPTIONS is not set
CONFIG_SERIAL_8250_CONSOLE=y
CONFIG_SERIAL_8250_NR_UARTS=2
CONFIG_SERIAL_8250_RUNTIME_UARTS=2
CONFIG_SERIAL_8250_MT6577=y
# CONFIG_HW_RANDOM is not set
CONFIG_I2C_MTK=y
CONFIG_SPI=y
CONFIG_SPI_MT65XX=y
CONFIG_MTK_GAUGE_VERSION=30
CONFIG_MTK_CHARGER=y
CONFIG_MTK_SWCHR_SUPPORT=y
CONFIG_MTK_KERNEL_POWER_OFF_CHARGING=y
# CONFIG_MTK_PUMP_EXPRESS_PLUS_SUPPORT is not set
# CONFIG_MTK_PUMP_EXPRESS_PLUS_20_SUPPORT is not set
CONFIG_HW_GADGET=y
CONFIG_HUAWEI_USB=y
# CONFIG_MTK_DUAL_CHARGER_SUPPORT is not set
CONFIG_CHARGER_RT9465=y
# CONFIG_HWMON is not set
CONFIG_THERMAL=y
CONFIG_THERMAL_DEFAULT_GOV_BACKWARD_COMPATIBLE=y
CONFIG_WATCHDOG=y
CONFIG_MTK_WATCHDOG_COMMON=y
CONFIG_MTK_WATCHDOG_COMMON_V2=y
CONFIG_REGULATOR=y
CONFIG_DRM=y
CONFIG_FB_MODE_HELPERS=y
CONFIG_FB_TILEBLITTING=y
CONFIG_LOGO=y
CONFIG_SOUND=y
CONFIG_SND=y
CONFIG_SND_SEQUENCER=y
CONFIG_SND_SEQ_DUMMY=y
CONFIG_SND_SEQUENCER_OSS=y
CONFIG_SND_HRTIMER=y
CONFIG_SND_DYNAMIC_MINORS=y
CONFIG_SND_SOC_MTK_AUDIO_PA=y
# CONFIG_SND_SPI is not set
CONFIG_SND_USB_AUDIO=y
CONFIG_MTK_UAC_POWER_SAVING=y
CONFIG_SND_SOC=y
CONFIG_MTK_SND_SOC_CODEC="mt6357"
CONFIG_SND_SOC_MTK_BTCVSD=y
CONFIG_MTK_SND_SOC_NEW_ARCH=y
CONFIG_SND_SOC_RT5509=y
CONFIG_SOUND_PRIME=y
CONFIG_HIDRAW=y
CONFIG_UHID=y
CONFIG_HID_A4TECH=y
CONFIG_HID_APPLE=y
CONFIG_HID_BELKIN=y
CONFIG_HID_CHERRY=y
CONFIG_HID_CHICONY=y
CONFIG_HID_CYPRESS=y
CONFIG_HID_DRAGONRISE=y
CONFIG_HID_EZKEY=y
CONFIG_HID_KYE=y
CONFIG_HID_GYRATION=y
CONFIG_HID_TWINHAN=y
CONFIG_HID_KENSINGTON=y
CONFIG_HID_LOGITECH=y
CONFIG_HID_MAGICMOUSE=y
CONFIG_HID_MICROSOFT=y
CONFIG_HID_MONTEREY=y
CONFIG_HID_PANTHERLORD=y
CONFIG_HID_PETALYNX=y
CONFIG_HID_SAMSUNG=y
CONFIG_HID_SUNPLUS=y
CONFIG_HID_GREENASIA=y
CONFIG_HID_SMARTJOYPLUS=y
CONFIG_HID_TOPSEED=y
CONFIG_HID_THRUSTMASTER=y
CONFIG_HID_ZEROPLUS=y
CONFIG_USB=y
CONFIG_USB_STORAGE=y
CONFIG_USB_STORAGE_DATAFAB=y
CONFIG_USB_STORAGE_FREECOM=y
CONFIG_USB_STORAGE_ISD200=y
CONFIG_USB_STORAGE_USBAT=y
CONFIG_USB_STORAGE_SDDR09=y
CONFIG_USB_STORAGE_SDDR55=y
CONFIG_USB_STORAGE_JUMPSHOT=y
CONFIG_USB_STORAGE_ALAUDA=y
CONFIG_USB_STORAGE_ONETOUCH=y
CONFIG_USB_STORAGE_KARMA=y
CONFIG_USB_STORAGE_CYPRESS_ATACB=y
CONFIG_USB_TRANCEVIBRATOR=y
CONFIG_NOP_USB_XCEIV=y
CONFIG_DUAL_ROLE_USB_INTF=y
CONFIG_USB_GADGET_VBUS_DRAW=500
CONFIG_USB_CONFIGFS_SERIAL=y
CONFIG_USB_CONFIGFS_ACM=y
CONFIG_USB_CONFIGFS_RNDIS=y
CONFIG_USB_CONFIGFS_MASS_STORAGE=y
CONFIG_USB_CONFIGFS_F_HID=y
CONFIG_MMC=y
CONFIG_MMC_BLOCK_MINORS=32
CONFIG_MMC_FFU=y
CONFIG_MTK_MMC_PWR_WP=y
CONFIG_MMC_MTK_PRO=y
CONFIG_MTK_EMMC_SUPPORT=y
CONFIG_MTK_EMMC_CACHE=y
CONFIG_MTK_EMMC_CQ_SUPPORT=y
CONFIG_HUAWEI_RWLOG=y
CONFIG_NEW_LEDS=y
CONFIG_LEDS_CLASS=y
CONFIG_LEDS_TRIGGERS=y
CONFIG_LEDS_TRIGGER_TIMER=y
CONFIG_MT6370_PMU_RGBLED=y
# CONFIG_RTC_SYSTOHC is not set
CONFIG_DMADEVICES=y
CONFIG_DMA_MTK_UART=y
CONFIG_SW_SYNC=y
CONFIG_ANDROID_LOW_MEMORY_KILLER=y
CONFIG_ANDROID_INTF_ALARM_DEV=y
CONFIG_ION=y
CONFIG_HW_BINDER_FG_REQ_FIRST=y
CONFIG_MTK_ION=y
CONFIG_NANOHUB=y
CONFIG_NANOHUB_MTK_IPI=y
CONFIG_MAILBOX=y
CONFIG_MTK_CMDQ_MBOX=y
CONFIG_IIO=y
CONFIG_OVERLAY_FS=y
CONFIG_EXT4_FS=y
CONFIG_EXT4_FS_SECURITY=y
CONFIG_EXT4_ENCRYPTION=y
CONFIG_F2FS_FS=y
CONFIG_F2FS_STAT_FS=y
CONFIG_F2FS_FS_SECURITY=y
CONFIG_F2FS_FS_ENCRYPTION=y
CONFIG_F2FS_JOURNAL_APPEND=y
CONFIG_F2FS_GRADING_SSR=y
CONFIG_HUAWEI_F2FS_DSM=y
CONFIG_EROFS_FS=y
CONFIG_EROFS_FS_DEBUG=y
CONFIG_EROFS_FS_XATTR=y
CONFIG_EROFS_FS_POSIX_ACL=y
CONFIG_EROFS_FS_SECURITY=y
CONFIG_EROFS_FS_USE_VM_MAP_RAM=y
CONFIG_EROFS_FAULT_INJECTION=y
CONFIG_EROFS_FS_ZIP=y
CONFIG_EROFS_FS_CLUSTER_PAGE_LIMIT=1
# CONFIG_EROFS_FS_ZIP_NO_CACHE is not set
# CONFIG_EROFS_FS_ZIP_CACHE_UNIPOLAR is not set
CONFIG_EROFS_FS_ZIP_CACHE_BIPOLAR=y
CONFIG_EROFS_FS_HUAWEI_EXTENSION=y
CONFIG_QUOTA=y
CONFIG_QUOTA_NETLINK_INTERFACE=y
CONFIG_QFMT_V2=y
CONFIG_FUSE_FS=y
CONFIG_ISO9660_FS=y
CONFIG_JOLIET=y
CONFIG_ZISOFS=y
CONFIG_MSDOS_FS=y
CONFIG_VFAT_FS=y
CONFIG_TMPFS=y
CONFIG_SDCARD_FS=y
CONFIG_PSTORE=y
CONFIG_PSTORE_CONSOLE=y
CONFIG_PSTORE_PMSG=y
CONFIG_PSTORE_RAM=y
CONFIG_PSTORE_CONSOLE_SIZE=0x40000
CONFIG_PSTORE_PMSG_SIZE=0x10000
CONFIG_PSTORE_MEM_ADDR=0x47C90000
CONFIG_PSTORE_MEM_SIZE=0xe0000
# CONFIG_NETWORK_FILESYSTEMS is not set
CONFIG_NLS_CODEPAGE_437=y
CONFIG_NLS_CODEPAGE_950=y
CONFIG_NLS_ASCII=y
CONFIG_NLS_ISO8859_1=y
CONFIG_NLS_UTF8=y
CONFIG_PRINTK_TIME=y
# CONFIG_DYNAMIC_DEBUG is not set
CONFIG_DEBUG_INFO=y
CONFIG_FRAME_WARN=2800
CONFIG_PANIC_ON_OOPS=y
CONFIG_PANIC_TIMEOUT=1
CONFIG_SCHEDSTATS=y
CONFIG_HUAWEI_LMK_DBG=y
# CONFIG_HUAWEI_LMK_AGAIN is not set
# CONFIG_DEBUG_PREEMPT is not set
# CONFIG_DEBUG_BUGVERBOSE is not set
CONFIG_RCU_CPU_STALL_TIMEOUT=60
CONFIG_FAULT_INJECTION=y
CONFIG_ENABLE_DEFAULT_TRACERS=y
CONFIG_MTK_SCHED_TRACERS=y
CONFIG_SECURITY_SELINUX_BOOTPARAM=y
CONFIG_HIE=y
CONFIG_HUAWEI_SELINUX_DSM=y
CONFIG_CRYPTO_XCBC=y
CONFIG_CRYPTO_TWOFISH=y
# CONFIG_CRYPTO_HW is not set
CONFIG_ARM64_CRYPTO=y
CONFIG_CRYPTO_SHA1_ARM64_CE=y
CONFIG_CRYPTO_SHA2_ARM64_CE=y
CONFIG_CRYPTO_AES_ARM64_CE_BLK=y
CONFIG_HUAWEI_DUBAI=y
# CONFIG_HUAWEI_GOLDENEYE is not set
# CONFIG_HUAWEI_BOOT_LOG is not set
# CONFIG_LOG_SWITCH is not set
CONFIG_HUAWEI_DSM=y
CONFIG_HUAWEI_DSM_AUDIO=y
CONFIG_HUAWEI_SDCARD_VOLD=y
CONFIG_HUAWEI_SDCARD_DSM=y
CONFIG_HUAWEI_EMMC_DSM=y
CONFIG_LOG_JANK=y
CONFIG_HIVIEW_SELINUX=y
CONFIG_HW_LOGGER=y
CONFIG_LOGGER_EXTEND=y
CONFIG_LOG_EXCEPTION=y
CONFIG_HWLOG_KERNEL=y
CONFIG_HANDSET_SYSRQ_RESET=y
#enable rphone
CONFIG_HUAWEI_KERNEL=y
CONFIG_HUAWEI_KERNEL_DEBUG=y
CONFIG_HW_FDLEAK=y
#enable TEE
# CONFIG_MICROTRUST_TEE_SUPPORT is not set
#
# TEE OS
#
CONFIG_SECURE_EXTENSION=y
CONFIG_TZDRIVER=y
CONFIG_TEE_CFC_ABI=y
CONFIG_TEELOG=y
CONFIG_TEE_NOTIFY_IRQ=y

CONFIG_HUAWEI_BFM=y
CONFIG_HW_BFMR_MTK=y
CONFIG_USE_BOOTFAIL_RECOVERY_SOLUTION=y
#config for huawei charge
CONFIG_HUAWEI_CHARGER=y
#config for huawei devices selfcheck
CONFIG_HUAWEI_DEV_SELFCHECK=y
#config for huawei sensors
CONFIG_HUAWEI_SENSORS=y
CONFIG_LCD_KIT_MTK=y
CONFIG_LCD_KIT_COMMON=y
CONFIG_LCD_KIT_DRIVER=y
CONFIG_MTK_LCD_KIT=y
CONFIG_NFC_CHIP_NXP=y
CONFIG_HW_SD_HEALTH_DETECT=y
CONFIG_EXFAT_FS=y
CONFIG_EXFAT_DISCARD=y
CONFIG_EXFAT_DELAYED_SYNC=y
# CONFIG_EXFAT_KERNEL_DEBUG is not set
# add for iaware memory dfx
CONFIG_HW_MEMORY_MONITOR=y
CONFIG_HUAWEI_SLOW_PATH_COUNT=y
CONFIG_SPECULATIVE_PAGE_FAULT=y
CONFIG_TASK_DELAY_ACCT=y
# add for iaware memory managemant
CONFIG_HUAWEI_BINDER_ASHMEM=y
CONFIG_HUAWEI_UNMOVABLE_ISOLATE=y
CONFIG_HUAWEI_UNMOVABLE_ISOLATE1_SIZE_MBYTES=256
CONFIG_HUAWEI_UNMOVABLE_ISOLATE2_SIZE_MBYTES=40
CONFIG_TCP_NODELAY=y
CONFIG_HUAWEI_PROC_MEMORYINFO_FAST=y
CONFIG_HUAWEI_SWAP_ZDATA=y
CONFIG_PGTABLE_MAPPING=y
CONFIG_HUAWEI_DIRECT_SWAPPINESS=y
CONFIG_TASK_PROTECT_LRU=y
CONFIG_SHRINK_MEMORY=y
CONFIG_PROCESS_RECLAIM=y
CONFIG_HW_CGROUP_WORKINGSET=y
CONFIG_TASK_DELAY_ACCT=y
# CONFIG_EXFAT_DEBUG_MSG is not set
CONFIG_EXFAT_DEFAULT_CODEPAGE=437
CONFIG_EXFAT_DEFAULT_IOCHARSET="utf8"
CONFIG_HUAWEI_RCC=y
CONFIG_HUAWEI_KSTATE=y
CONFIG_ANTENNA_BOARDID_GPIO_DETECT=y
CONFIG_HUAWEI_VIRT_TO_PHYS=y

CONFIG_RTC_HCTOSYS_DEVICE="rtc0"

CONFIG_HW_VIP_THREAD=y
CONFIG_HW_IAWARE_THREAD_BOOST=y
CONFIG_HW_CPULOAD_NOTI=y

CONFIG_OASES=y
CONFIG_OASES_SIGNATURE_SUPPORT=y
CONFIG_OASES_STATIC_PLTS=y

CONFIG_HUAWEI_BOOST_KILL=y

# Huawei jank
CONFIG_SCHED_HWSTATUS=y

# Huawei Kernel Harden
CONFIG_HUAWEI_KASLR_DEBUGFS=y
CONFIG_SLAB_FREELIST_RANDOM=y
CONFIG_HUAWEI_FREELIST_RANDOM_DEBUGFS=y

# Huawei thermal config AR000AFR67
CONFIG_HUAWEI_THERMAL_HWNODE=y

# add for check_root
CONFIG_HUAWEI_PROC_CHECK_ROOT=y
CONFIG_HW_ROOT_SCAN=y
CONFIG_HW_KERNEL_STP=y

# huawei audio drivers
CONFIG_AUDIOKIT=y
CONFIG_HUAWEI_DEVICEBOX_AUDIO=y
CONFIG_HUAWEI_SMARTPAKIT_AUDIO=y
CONFIG_HUAWEI_AUDIO=y
CONFIG_CS35L41=y

CONFIG_HW_DIE_CATCH=y
CONFIG_HUAWEI_STATISTICS=y
CONFIG_HUAWEI_KSTATE=y
CONFIG_INET_UDP_DIAG=y

CONFIG_HUAWEI_SCAN_SEEK=y
CONFIG_HW_SYN_LINEAR_RETRY=y
CONFIG_CHR_MTK_NETLINK=y
#add for IO_TRACE
CONFIG_HUAWEI_IO_TRACING=y
```
